## Kconfig
```kconfig
config ZMK_WATCHDOG
    bool "Enable firmware watchdog incident logging"
    select SETTINGS
    select CRC
    select ZMK_LOW_PRIORITY_WORK_QUEUE
    select HWINFO

if ZMK_WATCHDOG

config ZMK_WATCHDOG_MAX_INCIDENTS
    int "Maximum number of stored incidents (flash slot cap, per half)"
    default 16
    help
      Flash-wear protection: once this many incidents are stored, recording
      stops (no ring-buffer overwrite) until the user deletes incidents.

config ZMK_WATCHDOG_PENDING_CONVERT_DELAY_MS
    int "Delay before converting a pending incident at boot (ms)"
    default 100
    help
      The pending-slot boot conversion needs the settings subsystem to have
      finished settings_load() (called from main(), after every SYS_INIT
      level runs). There is no "settings loaded" hook to wait on, so
      conversion is instead scheduled on the low-priority work queue after
      this delay, which comfortably follows main()'s settings_load() call
      for the tiny number of keys this module and typical configs persist.

config ZMK_WATCHDOG_STUDIO_RPC
    bool "Expose watchdog incident log via custom Studio RPC"
    depends on ZMK_STUDIO
    select ZMK_WATCHDOG_PROTOBUF

# Hidden: pulls in nanopb (+ the same encoding options ZMK_STUDIO itself
# implies) for whichever of ZMK_WATCHDOG_STUDIO_RPC/ZMK_WATCHDOG_SPLIT_RELAY
# is enabled -- a split peripheral build enables the latter without
# ZMK_STUDIO (which is what normally selects NANOPB), so this module must
# select it itself rather than assuming ZMK_STUDIO already did.
config ZMK_WATCHDOG_PROTOBUF
    bool
    select NANOPB
    imply NANOPB_NO_ERRMSG
    imply NANOPB_WITHOUT_64BIT
    imply NANOPB_NO_ENCODE_SIZE_CHECK

config ZMK_WATCHDOG_SPLIT_RELAY
    bool "Relay watchdog Studio RPC to split peripherals"
    default y if ZMK_SPLIT
    depends on ZMK_SPLIT_RELAY_EVENT
    select ZMK_WATCHDOG_PROTOBUF
    help
      Verified end-to-end on real split hardware (DESIGN.md SS12.1,
      2026-07-07): a relayed GetStatus request completes correctly, with
      the central's DeferredResponse followed by a PeripheralResponse
      Studio notification carrying the peripheral's real answer.
      Previous hardware sessions could not get a relayed request to
      complete and shipped this default off while investigating; the
      actual cause turned out to be leftover diagnostic code in this
      module (an early `return` before the peripheral ever executed the
      request), not a transport or timing issue -- see DESIGN.md SS12.1
      for the full writeup.

      Enable on BOTH halves of a split keyboard to reach a peripheral's
      own incident log through the
      central's cormoran__watchdog Studio RPC subsystem: any GetStatus/
      ListIncidents/DeleteIncidents request with a nonzero `source` is
      relayed to the matching peripheral over CONFIG_ZMK_SPLIT_RELAY_EVENT,
      and the response arrives back as a PeripheralResponse Studio
      notification (relaying is asynchronous, unlike a local request). A
      ListIncidents answer streams one incident per relay event rather
      than a whole page in one event, so CONFIG_ZMK_SPLIT_RELAY_EVENT_DATA_LEN
      never needs to be raised above its framework default for this module
      (see src/split/watchdog_relay.c's BUILD_ASSERTs and DESIGN.md SS7.1).
      Note: the underlying split relay event transport broadcasts to every
      connected peripheral, not to one addressed peripheral -- with more
      than one peripheral, every peripheral answers every relayed request
      (each correctly tagged with its own source), which does not compose
      well with a UI that only expects an answer from a specific one. Safe
      to enable for a build with a single peripheral. There is also no way
      for the central to know which peripheral slots are currently
      connected, so a relayed request to a disconnected peripheral simply
      never produces a response -- the web UI must time out on its own.

config ZMK_WATCHDOG_SPLIT_RELAY_TEST
    bool "Enable native_sim-only watchdog split relay test hooks"
    depends on ZMK_WATCHDOG_SPLIT_RELAY
    help
      Adds a boot-time self-test that bypasses the real split transport
      (which native_sim cannot exercise end-to-end) and asserts firmware
      behavior directly, printing PASS/FAIL to the log:
        - Peripheral role: synthesizes a relayed ListIncidents/
          DeleteIncidents request locally and asserts the resulting relay
          response, exercising watchdog_request_exec_handle() the same way
          a real relayed request would.
        - Central role: asserts watchdog_relay_dispatch_request() always
          returns a DeferredResponse with a distinct, nonzero request_id.
      Not for production builds.

config ZMK_WATCHDOG_SPLIT_RELAY_TEST_DELAY_MS
    int "Delay this self-test's boot-time run (ms)"
    default 0
    depends on ZMK_WATCHDOG_SPLIT_RELAY_TEST
    help
      Both test hooks normally run synchronously inside a SYS_INIT at
      APPLICATION priority, at the same moment BLE scanning/pairing/GATT
      discovery are starting. Setting this above 0 defers the test (via a
      k_work_delayable on the system workqueue) by that many ms instead --
      purely for A/B hardware experiments isolating whether running
      *anything* at this exact boot moment (as opposed to this specific
      test's own logic, which never touches the real BLE transport --
      see the test's own doc comment) affects radio-scheduling stability.
      Not expected to matter in itself; kept at 0 unless actively testing
      that hypothesis (DESIGN.md SS12.1).

config ZMK_WATCHDOG_FREEZE_DETECT
    bool "Detect long thread/work-queue freezes via Zephyr's task watchdog"
    default y
    select TASK_WDT
    help
      Monitors the system workqueue (and the ZMK low-priority workqueue) with
      one task_wdt channel each, fed by a self-rescheduling k_work_delayable
      on the monitored queue itself. If a queue is blocked longer than
      CONFIG_ZMK_WATCHDOG_FREEZE_TIMEOUT_MS, the feed work never runs and the
      channel's callback records a FREEZE incident and reboots.

if ZMK_WATCHDOG_FREEZE_DETECT

config ZMK_WATCHDOG_FREEZE_TIMEOUT_MS
    int "Freeze detection timeout (ms)"
    default 5000
    help
      task_wdt channel timeout for each monitored work queue. The feed period
      is this value divided by CONFIG_ZMK_WATCHDOG_FREEZE_FEED_DIVISOR. Keep
      this well above worst-case legitimate stalls (BLE connection storms,
      settings flash writes) but short enough that a real freeze is noticed
      quickly.

config ZMK_WATCHDOG_FREEZE_FEED_DIVISOR
    int "Feed period divisor (feed period = timeout / this)"
    default 2
    range 2 10
    help
      Each monitored queue's feed work is a k_work_delayable that
      re-schedules itself every (CONFIG_ZMK_WATCHDOG_FREEZE_TIMEOUT_MS /
      this) ms, which under the hood is backed by its own Zephyr k_timer.
      Lowering this divisor (default 2, meaning "feed twice as often as the
      timeout") reduces how often that timer fires while staying safely
      inside the timeout window. A lower feed *frequency* is a mitigation
      (not a fix) for a real, hardware-confirmed, low-probability BLE
      controller radio-timing issue on split-central builds: any extra
      periodic k_timer activity from this module is one more thing that can
      occasionally coincide with the BLE controller's own extremely tight
      (~275us) radio-event-preparation timing budget, tripping Zephyr's own
      LL_ASSERT_OVERHEAD safety check and rebooting -- see DESIGN.md SS12.1.
      This does not eliminate that risk (it is architecturally outside this
      module's control -- the LLL radio ISR runs at the highest interrupt
      priority and this module cannot delay it directly), it only reduces
      how often this module contributes extra timer load that could
      coincide with it.

config ZMK_WATCHDOG_FREEZE_STARTUP_DELAY_MS
    int "Delay before arming the freeze detector after boot (ms)"
    default 0
    help
      task_wdt_init()/task_wdt_add() and this module's own feed timers
      normally start synchronously inside a SYS_INIT at APPLICATION
      priority -- i.e. at the same moment the BLE stack is bringing up
      scanning/pairing/GATT discovery, the busiest and most tightly
      scheduled period for the radio (DESIGN.md SS12.1). Setting this above
      0 defers arming (via a k_work_delayable on the system workqueue) by
      that many ms, so this module's own periodic timer activity doesn't
      begin until initial connection establishment has settled down. This
      delays freeze detection coverage by the same amount (a real freeze
      during the delay window goes undetected) and is an experimental
      mitigation, not a proven fix -- see DESIGN.md SS12.1 for the hardware
      test that motivated it and its (inconclusive) result.

config ZMK_WATCHDOG_FREEZE_MONITOR_LOWPRIO_QUEUE
    bool "Also monitor ZMK's low-priority work queue"
    default y
    help
      In addition to the system workqueue (always monitored -- key event
      processing lives there, see DESIGN.md SS4.1), also arm a task_wdt
      channel + feed timer for ZMK's low-priority work queue. Disabling this
      halves this module's own periodic k_timer footprint (see
      CONFIG_ZMK_WATCHDOG_FREEZE_FEED_DIVISOR's help for why that matters on
      split-central builds), at the cost of no longer detecting freezes that
      are specific to the low-priority queue alone (freezes on the system
      workqueue, the more critical case, are still caught either way).

endif # ZMK_WATCHDOG_FREEZE_DETECT

config ZMK_WATCHDOG_FATAL_DETECT
    bool "Detect hard faults (stack overflow, bus fault, oops/panic, ...)"
    default y
    help
      Overrides the weak k_sys_fatal_error_handler() to record a FATAL
      incident (reason, PC, LR, thread name) before rebooting, instead of
      Zephyr's default behavior of halting forever. Any other code in the
      application that also overrides k_sys_fatal_error_handler will
      silently conflict with this one at link time (last object wins) --
      there is no compile-time error.

config ZMK_WATCHDOG_TEST_INJECTION
    bool "Enable dangerous test/fault injection helpers"
    default n
    help
      Adds internal helpers that deliberately freeze a monitored work queue
      or trigger a kernel oops, for validating the freeze/fatal detectors
      end-to-end (native_sim tests, hardware bring-up). Never enable this in
      a production build.

      Two ways to trigger them once enabled:
        - Studio RPC (central / non-split boards): cormoran.watchdog's
          InjectTestRequest, wired up in
          src/studio/watchdog_request_exec.c.
        - Boot-delay auto-trigger (split peripherals, which have no Studio
          RPC of their own): CONFIG_ZMK_WATCHDOG_TEST_INJECT_FREEZE_AT_BOOT_MS /
          CONFIG_ZMK_WATCHDOG_TEST_INJECT_FATAL_AT_BOOT_MS below.

if ZMK_WATCHDOG_TEST_INJECTION

config ZMK_WATCHDOG_TEST_INJECT_FREEZE_AT_BOOT_MS
    int "Auto-trigger a freeze this many ms after boot (0 = disabled)"
    default 0
    help
      When > 0, schedules zmk_watchdog_inject_freeze() via a k_work_delayable
      this many ms after boot. Intended for split peripherals, which have no
      Studio RPC to receive an on-demand InjectTestRequest -- flash a test
      build with this set, power-cycle, and observe the freeze/reboot/
      incident-recorded cycle without needing any host-side tooling. Leave 0
      (the default) for boards that trigger injection via Studio RPC instead
      (see CONFIG_ZMK_WATCHDOG_TEST_INJECTION's help).

config ZMK_WATCHDOG_TEST_INJECT_FATAL_AT_BOOT_MS
    int "Auto-trigger a fatal error this many ms after boot (0 = disabled)"
    default 0
    help
      Same as CONFIG_ZMK_WATCHDOG_TEST_INJECT_FREEZE_AT_BOOT_MS, but calls
      zmk_watchdog_inject_fatal() (k_oops()) instead. If both this and
      CONFIG_ZMK_WATCHDOG_TEST_INJECT_FREEZE_AT_BOOT_MS are set, whichever
      fires first reboots the device before the other's timer elapses --
      only set one at a time in practice.

endif # ZMK_WATCHDOG_TEST_INJECTION

config ZMK_WATCHDOG_TEST
    bool "Enable watchdog self-test (native_sim only)"
    help
      Adds test-only init logic exercising the store and pending-slot boot
      conversion. Not for production builds.

config ZMK_WATCHDOG_STUDIO_RPC_TEST
    bool "Enable watchdog Studio RPC self-test (native_sim only)"
    depends on ZMK_WATCHDOG_STUDIO_RPC
    help
      Adds test-only init logic exercising src/studio/watchdog_handler.c's
      GetStatus/ListIncidents/DeleteIncidents handlers directly (no
      transport). Built separately from CONFIG_ZMK_WATCHDOG_TEST because it
      needs CONFIG_ZMK_STUDIO, which in turn needs a physical-layout
      devicetree (see tests/studio/ vs tests/watchdog/). Not for production
      builds.

endif
```
